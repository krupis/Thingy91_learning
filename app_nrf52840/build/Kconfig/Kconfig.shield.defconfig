## app_nrf52840/build/Kconfig/Kconfig.shield.defconfig
```kconfig
osource "c:/users/petrikas.lu/desktop/work/nrf/thingy_91/app_nrf9160/boards/shields/*/Kconfig.defconfig"
osource "c:/users/petrikas.lu/desktop/work/nrf/thingy_91/app_nrf52840/boards/shields/*/Kconfig.defconfig"
osource "C:/Users/petrikas.lu/Desktop/WORK/NRF/Thingy_91/external/nrf/boards/shields/*/Kconfig.defconfig"
```

## app_nrf52840/build/Kconfig/Kconfig.sysbuild.modules
```kconfig
menu "nrf (C:/Users/petrikas.lu/Desktop/WORK/NRF/Thingy_91/external/nrf)"
osource "C:/Users/petrikas.lu/Desktop/WORK/NRF/Thingy_91/external/nrf/sysbuild/Kconfig.sysbuild"
config ZEPHYR_NRF_MODULE
	bool
	default y
endmenu
```

## app_nrf9160/build/Kconfig/Kconfig.shield
```kconfig
osource "c:/users/petrikas.lu/desktop/work/nrf/thingy_91/app_nrf9160/boards/shields/*/Kconfig.shield"
osource "c:/users/petrikas.lu/desktop/work/nrf/thingy_91/app_nrf52840/boards/shields/*/Kconfig.shield"
osource "C:/Users/petrikas.lu/Desktop/WORK/NRF/Thingy_91/external/nrf/boards/shields/*/Kconfig.shield"
```

## app_nrf9160/build/mcuboot/Kconfig/Kconfig.shield.defconfig
```kconfig
osource "C:/Users/petrikas.lu/Desktop/WORK/NRF/Thingy_91/external/nrf/boards/shields/*/Kconfig.defconfig"
```
